## conf/bblayers.conf
```bitbake
# LAYER_CONF_VERSION is increased each time build/conf/bblayers.conf
# changes incompatibly
LCONF_VERSION = "6"
OEROOT := "${@os.path.abspath(os.path.dirname(d.getVar('FILE', True)))}/../.."

BBPATH = "${TOPDIR}"

BBFILES = ""

# These layers hold recipe metadata not found in OE-core, but lack any machine or distro content
BBLAYERS = " \
  ${OEROOT}/layers/poky/meta \
  ${OEROOT}/layers/meta-luv \
  ${OEROOT}/layers/meta-openembedded/meta-oe \
"
```
